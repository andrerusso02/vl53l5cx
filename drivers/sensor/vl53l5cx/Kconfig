## drivers/sensor/vl53l5cx/Kconfig
```kconfig
# VL53L5CX configuration

menuconfig VL53L5CX
    bool "VL53L5CX Time of Flight sensor"
    default y
    depends on DT_HAS_ST_VL53L5CX_ENABLED
    select I2C
    help
      Enable driver for VL53L5CX I2C-based multizone ToF sensor.

if VL53L5CX

menu "VL53L5CX Options"

choice VL53L5CX_RESOLUTION
    prompt "Sensor resolution"
    default VL53L5CX_RESOLUTION_4X4
    help
      Set the spatial resolution of the sensor.

config VL53L5CX_RESOLUTION_4X4
    bool "4x4 (16 zones)"

config VL53L5CX_RESOLUTION_8X8
    bool "8x8 (64 zones)"

endchoice

config VL53L5CX_RANGING_FREQ
    int "Ranging frequency (Hz)"
    default 10
    range 1 60
    help
      Frequency of measurements.

endmenu

endif # VL53L5CX

# TODO: add interrupt support
```

## dts/bindings/sensor/st,vl53l5cx.yaml
```yaml
description: |
    STMicroelectronics VL53L5CX. 

compatible: "st,vl53l5cx"

include: [sensor-device.yaml, i2c-device.yaml]

properties:
  lpn-gpios:
    type: phandle-array
    description: |
      GPIO connected to the LPn pin. This pin is used to enable/disable 
      I2C communication and is required for multi-sensor address reconfiguration.
```
